## Config.in
```kconfig
menu "az0x firmware kit"
source "$BR2_EXTERNAL_AZ0X_PATH/package/az0x-app/Config.in"
source "$BR2_EXTERNAL_AZ0X_PATH/package/az0x-tools/Config.in"
source "$BR2_EXTERNAL_AZ0X_PATH/package/az0x-sftp-server/Config.in"
source "$BR2_EXTERNAL_AZ0X_PATH/package/az0x-rk-vcodec/Config.in"
source "$BR2_EXTERNAL_AZ0X_PATH/package/az0x-rockchip-mpp/Config.in"
endmenu
```

## package/az0x-rk-vcodec/Config.in
```kconfig
config BR2_PACKAGE_AZ0X_RK_VCODEC
	bool "az0x-rk-vcodec"
	depends on BR2_LINUX_KERNEL
	help
	  The RK3288's hardware video encoder (VEPU1: H.264, VP8, JPEG):
	  Rockchip's own MPP kernel driver, trimmed to the encoder and
	  ported to the kit's mainline kernel. Gives /dev/mpp_service for
	  Rockchip's MPP library (az0x-rockchip-mpp). Needs the vepu and
	  mpp-srv device tree nodes (gen1/common/patches/linux).

comment "az0x-rk-vcodec needs a Linux kernel to be built"
	depends on !BR2_LINUX_KERNEL
```

## package/az0x-rockchip-mpp/Config.in
```kconfig
config BR2_PACKAGE_AZ0X_ROCKCHIP_MPP
	bool "az0x-rockchip-mpp"
	depends on BR2_INSTALL_LIBSTDCPP
	depends on BR2_TOOLCHAIN_HAS_THREADS
	help
	  Rockchip's Media Process Platform library (librockchip_mpp):
	  the user side of the hardware video codecs. On the RK3288 it
	  drives the H.264 / VP8 / JPEG encoder through az0x-rk-vcodec.
	  Also installs mpi_enc_test, Rockchip's encoder test program.

	  https://github.com/rockchip-linux/mpp
```

## package/az0x-sftp-server/Config.in
```kconfig
config BR2_PACKAGE_AZ0X_SFTP_SERVER
	bool "az0x-sftp-server"
	help
	  OpenSSH's sftp-server only (BSD licence), at /usr/libexec/sftp-server
	  where dropbear looks for it: file managers (Nautilus, WinSCP, FileZilla)
	  can browse the device over SFTP. No sshd: dropbear stays the SSH server.
```
