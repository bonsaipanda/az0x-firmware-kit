## Config.in
```kconfig
menu "az0x firmware kit"
source "$BR2_EXTERNAL_AZ0X_PATH/package/az0x-app/Config.in"
source "$BR2_EXTERNAL_AZ0X_PATH/package/az0x-tools/Config.in"
endmenu
```

## gen1/force/buildroot.defconfig
```kconfig
# Akai Force (gen1, "ADA2", RK3288)

# CPU
BR2_arm=y
BR2_cortex_a17=y
BR2_ARM_FPU_NEON_VFPV4=y

# Toolchain
BR2_TOOLCHAIN_BUILDROOT_GLIBC=y
BR2_TOOLCHAIN_BUILDROOT_CXX=y
BR2_KERNEL_HEADERS_AS_KERNEL=y
BR2_PACKAGE_HOST_LINUX_HEADERS_CUSTOM_6_18=y

# Downloads and patches
BR2_DOWNLOAD_FORCE_CHECK_HASHES=y
BR2_GLOBAL_PATCH_DIR="$(BR2_EXTERNAL_AZ0X_PATH)/gen1/common/patches"

# System
BR2_TARGET_GENERIC_HOSTNAME="force"
BR2_TARGET_GENERIC_ISSUE="az0x-firmware-kit (Force)"
BR2_INIT_BUSYBOX=y
BR2_ROOTFS_DEVICE_CREATION_DYNAMIC_EUDEV=y
# BR2_PACKAGE_IFUPDOWN_SCRIPTS is not set
BR2_ROOTFS_OVERLAY="$(BR2_EXTERNAL_AZ0X_PATH)/gen1/common/rootfs-overlay"
BR2_ROOTFS_POST_BUILD_SCRIPT="$(BR2_EXTERNAL_AZ0X_PATH)/gen1/common/post-build.sh"
BR2_ROOTFS_POST_IMAGE_SCRIPT="$(BR2_EXTERNAL_AZ0X_PATH)/gen1/common/post-image.sh"
BR2_ROOTFS_POST_SCRIPT_ARGS="force inmusic,ada2 09e8:4040"

# Kernel: inMusic's az01 kernel from their open source release
BR2_LINUX_KERNEL=y
BR2_LINUX_KERNEL_CUSTOM_TARBALL=y
BR2_LINUX_KERNEL_CUSTOM_TARBALL_LOCATION="https://media.githubusercontent.com/media/inmusic-software/az0x-open-source/ea21ffce863f48cfa138f053bfd5788daa752a6b/arm-poky-linux-gnueabi/linux-az01-6.18.44+git-r0/linux-az01-6.18.44+git-r0-patched.tar.xz"
BR2_LINUX_KERNEL_USE_CUSTOM_CONFIG=y
BR2_LINUX_KERNEL_CUSTOM_CONFIG_FILE="$(BR2_EXTERNAL_AZ0X_PATH)/gen1/common/linux.config"
BR2_LINUX_KERNEL_CONFIG_FRAGMENT_FILES="$(BR2_EXTERNAL_AZ0X_PATH)/gen1/common/linux.fragment"
BR2_LINUX_KERNEL_ZIMAGE=y
BR2_LINUX_KERNEL_DTS_SUPPORT=y
BR2_LINUX_KERNEL_INTREE_DTS_NAME="rockchip/rk3288-az01-ada2 rockchip/rk3288-az01-ada2-c"
BR2_LINUX_KERNEL_INSTALL_TARGET=y
BR2_LINUX_KERNEL_NEEDS_HOST_OPENSSL=y

# Packages
BR2_PACKAGE_ALSA_LIB=y
BR2_PACKAGE_ALSA_UTILS=y
BR2_PACKAGE_ALSA_UTILS_AMIDI=y
BR2_PACKAGE_ALSA_UTILS_AMIXER=y
BR2_PACKAGE_ALSA_UTILS_APLAY=y
BR2_PACKAGE_LIBDRM=y
BR2_PACKAGE_E2FSPROGS=y
BR2_PACKAGE_TRIGGERHAPPY=y
BR2_PACKAGE_LINUX_FIRMWARE=y
BR2_PACKAGE_LINUX_FIRMWARE_BRCM_BCM43XXX=y
BR2_PACKAGE_DROPBEAR=y
BR2_PACKAGE_IW=y
BR2_PACKAGE_WPA_SUPPLICANT=y
BR2_PACKAGE_WPA_SUPPLICANT_NL80211=y
BR2_PACKAGE_WPA_SUPPLICANT_CLI=y

# Root filesystem: must fit the 500 MiB rootfs partition
BR2_TARGET_ROOTFS_EXT2=y
BR2_TARGET_ROOTFS_EXT2_4=y
BR2_TARGET_ROOTFS_EXT2_SIZE="480M"
# BR2_TARGET_ROOTFS_TAR is not set

# Host tools
BR2_PACKAGE_HOST_UBOOT_TOOLS=y

# The app
BR2_PACKAGE_AZ0X_APP=y
```

## package/az0x-app/Config.in
```kconfig
config BR2_PACKAGE_AZ0X_APP
	bool "az0x-app (the application the device boots into)"
	default y
	help
	  Installs one application into /opt/app. At boot, init runs
	  /opt/app/start and restarts it if it exits.

	  The application is a local source directory with a Makefile
	  that supports "make" and "make install DESTDIR=...", and that
	  installs an executable /opt/app/start. The kit ships a small
	  example in app/hello.

if BR2_PACKAGE_AZ0X_APP

config BR2_PACKAGE_AZ0X_APP_SOURCE_DIR
	string "application source directory"
	default "$(BR2_EXTERNAL_AZ0X_PATH)/app/hello"
	help
	  Path to the application sources. Point this at your own
	  application to build a firmware for it.

endif
```

## package/az0x-tools/Config.in
```kconfig
config BR2_PACKAGE_AZ0X_TOOLS
	bool "az0x-tools (device helpers)"
	default y
	help
	  Small helpers for az0x devices. az0x-reboot restarts the
	  device with a reboot argument; "az0x-reboot loader" restarts
	  into Update Mode (fastboot). az0x-update installs an AZ01
	  update image (kit or stock) from a USB stick, SD card or /data
	  without a computer; az0x-img reads such images.
```
